/**
 * @cliArgs --board "/boards/LAUNCHXL_F28379D" --context "CPU1" --product "C2000WARE@5.02.00.00"
 * @versions {"tool":"1.20.0+3587"}
 */

/**
 * Import the modules used in this configuration.
 */
const can  = scripting.addModule("/driverlib/can.js", {}, false);
const can1 = can.addInstance();

/**
 * Write custom configuration values to the imported modules.
 */
can1.$name                   = "myCAN0";
can1.msgObjsUsed             = [1,2];
can1.enableInterrupt         = true;
can1.interruptFlags          = ["CAN_INT_IE0","CAN_INT_IE1"];
can1.registerInterrupts      = true;
can1.interruptLine           = ["CAN_GLOBAL_INT_CANINT0","CAN_GLOBAL_INT_CANINT1"];
can1.bitRate                 = "125000";
can1.can.canrxPin.$assign    = "GPIO17";
can1.can.cantxPin.$assign    = "GPIO12";
can1.msgObj1.$name           = "msgObj0";
can1.msgObj1.msgID           = 1962;
can1.msgObj1.msgType         = "CAN_MSG_OBJ_TYPE_TX";
can1.msgObj1.flags           = ["CAN_MSG_OBJ_TX_INT_ENABLE"];
can1.msgObj2.$name           = "msgObj1";
can1.msgObj2.msgID           = 1979;
can1.msgObj2.flags           = ["CAN_MSG_OBJ_RX_INT_ENABLE"];
can1.can0Int.enableInterrupt = true;
can1.can1Int.enableInterrupt = true;
scripting.suppress("Not pinned out,@@@.+?@@@ is not pinned out on the LaunchPad F28379D\\.  @@@.+?@@@", can1.can, "canrxPin");
scripting.suppress("Not pinned out,@@@.+?@@@ is not pinned out on the LaunchPad F28379D\\.  @@@.+?@@@", can1.can, "cantxPin");

/**
 * Pinmux solution for unlocked pins/peripherals. This ensures that minor changes to the automatic solver in a future
 * version of the tool will not impact the pinmux you originally saw.  These lines can be completely deleted in order to
 * re-solve from scratch.
 */
can1.can.$suggestSolution = "CANB";
